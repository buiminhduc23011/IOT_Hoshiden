## Firmware/sdkconfig.defaults
```kconfig
# Use a custom partition table
CONFIG_PARTITION_TABLE_CUSTOM=y
CONFIG_PARTITION_TABLE_CUSTOM_FILENAME="partitions.csv"
# Serial Flasher config
CONFIG_ESPTOOLPY_FLASHSIZE_4MB=y
CONFIG_ESPTOOLPY_FLASHSIZE="4MB"

#
# Modbus configuration
#
CONFIG_MB_COMM_MODE_RTU=y
CONFIG_FMB_TIMER_PORT_ENABLED=n
CONFIG_FMB_TIMER_ISR_IN_IRAM=y
CONFIG_FMB_TIMER_USE_ISR_DISPATCH_METHOD=y

CONFIG_ESP32_BROWNOUT_DET=n

#
# socketio-esp-idf
#
CONFIG_SIO_DEFAULT_EIO_VERSION=4
CONFIG_SIO_DEFAULT_SIO_URL_PATH="/socket.io"
CONFIG_SIO_DEFAULT_SIO_NAMESPACE="/"
CONFIG_SIO_MAX_PARALLEL_SOCKETS=10
CONFIG_SIO_DEFAULT_MESSAGE_QUEUE_SIZE=10
# end of socketio-esp-idf
```
