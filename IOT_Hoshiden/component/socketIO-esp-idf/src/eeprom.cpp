/*==================================================================================================
*   Project              :  IOT NIDEC
*   Doccument            :  socket.io
*   FileName             :  eeprom.cpp
*   File Description     :  Khai bao ham su dung NVS FLASH trong esp32
*
==================================================================================================*/
/*==================================================================================================
Revision History:
Modification     
    Author                  	Date D/M/Y     Description of Changes
----------------------------	----------     ------------------------------------------
    Do Xuan An              	12/03/2024     Tao file
----------------------------	----------     ------------------------------------------
==================================================================================================*/
/*==================================================================================================
*                                        INCLUDE FILES
==================================================================================================*/
#include "eeprom.h"
#include <esp_log.h>
#include <freertos/FreeRTOS.h>
#include <freertos/task.h>
#include <freertos/timers.h>
#include <string.h>
/*==================================================================================================
*                                     FILE VERSION CHECKS
==================================================================================================*/

/*==================================================================================================
*                          LOCAL TYPEDEFS (STRUCTURES, UNIONS, ENUMS)
==================================================================================================*/

/*==================================================================================================
*                                       LOCAL MACROS
==================================================================================================*/
/*==================================================================================================
*                                      LOCAL CONSTANTS
==================================================================================================*/
/*==================================================================================================
*                                      LOCAL VARIABLES
==================================================================================================*/
static char TAG[] = "NVS";
/*==================================================================================================
*                                      GLOBAL CONSTANTS
==================================================================================================*/
/*==================================================================================================
*                                      GLOBAL VARIABLES
==================================================================================================*/
/*==================================================================================================
*                                   LOCAL FUNCTION PROTOTYPES
==================================================================================================*/

/*==================================================================================================
*                                       LOCAL FUNCTIONS
==================================================================================================*/

/*==================================================================================================
*                                      GLOBAL FUNCTIONS
==================================================================================================*/


#ifdef DEBUG
#define ee_debug(fmt, args...)  ESP_LOGI(TAG, fmt, ## args);
#define ee_info(fmt, args...)   ESP_LOGI(TAG, fmt, ## args);
#define ee_error(fmt, args...)  ESP_LOGE(TAG, fmt, ## args);
#else
#define ee_debug(fmt, args...)
#define ee_info(fmt, args...)   ESP_LOGI(TAG, fmt, ## args);
#define ee_error(fmt, args...)  ESP_LOGE(TAG, fmt, ## args);
#endif

void Eeprom::begin(size_t size)
{
    esp_err_t err = nvs_flash_init();
    if (err == ESP_ERR_NVS_NO_FREE_PAGES || err == ESP_ERR_NVS_NEW_VERSION_FOUND) {
        ESP_ERROR_CHECK(nvs_flash_erase());
        err = nvs_flash_init();
    }
    ESP_ERROR_CHECK( err );
    err = nvs_open(_name, NVS_READWRITE, &my_handle);
    if (err != ESP_OK) {
       ee_info("Loi mo su kien \n", esp_err_to_name(err));
    } else {
       ee_info("Hoan thanh\n");
    }
}
//-------------------------------------------------------------------------------------------------
void Eeprom::commit()
{
    esp_err_t err = nvs_commit(my_handle);
    if (err != ESP_OK) {
        ee_info("Loi ghi: %s", esp_err_to_name(err));
    } else {
        ee_info("Da ghi thanh cong");
    }
}
//-------------------------------------------------------------------------------------------------
void Eeprom::end()
{
    nvs_close(my_handle);
}
//--------------------------------------------------------------------------------------------------
/*template <class T> T Eeprom::writeBase (int address, const T &value)
{
   
}
//--------------------------------------------------------------------------------------------------
template <class T> T Eeprom::readBase (int address, T &value)
{
  
}*/
//--------------------------------------------------------------------------------------------------
int Eeprom::writeString (char* namefield, char* value)
{
    esp_err_t err = nvs_set_str(my_handle, namefield, value);
    if (err == ESP_OK)
    {   
         commit();
         return (int)strlen(value);
    }
    else return 0;
}

//---------------------------------------------------------------------------------------------------
int Eeprom::readString (char* namefield, char* value)
{
    size_t size;
    esp_err_t err = nvs_get_str(my_handle, namefield, value, &size);
    if (err == ESP_OK)
    {   
         ee_info("string %s",value);  
         return (int)size;
    }
    else return 0;
  
}

//--------------------------------------------------------------------------------------------------
bool Eeprom::writeUint16 (char* namefield, uint16_t value)
{
    esp_err_t err = nvs_set_u16(my_handle, namefield, value);
    if (err == ESP_OK)
    {   
         commit();
         return true;
    }
    else return false;
}

//---------------------------------------------------------------------------------------------------
bool Eeprom::readUint16 (char* namefield, uint16_t* value)
{
    esp_err_t err = nvs_get_u16(my_handle, namefield, value);
    if (err == ESP_OK)
    {   
         return true;
    }
    else return false;
  
}
//======================================END FILE===================================================/
